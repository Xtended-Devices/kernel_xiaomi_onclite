## drivers/staging/android/Kconfig
```kconfig
menu "Android"

if ANDROID

config ASHMEM
	bool "Enable the Anonymous Shared Memory Subsystem"
	default n
	depends on SHMEM
	---help---
	  The ashmem subsystem is a new shared memory allocator, similar to
	  POSIX SHM but with different behavior and sporting a simpler
	  file-based API.

	  It is, in theory, a good memory allocator for low-memory devices,
	  because it can discard shared memory units when under memory pressure.

config ANDROID_LOW_MEMORY_KILLER
	bool "Android Low Memory Killer"
	---help---
	  Registers processes to be killed when low memory conditions, this is useful
	  as there is no particular swap space on android.

	  The registered process will kill according to the priorities in android init
	  scripts (/init.rc), and it defines priority values with minimum free memory size
	  for each priority.

config ANDROID_LOW_MEMORY_KILLER_AUTODETECT_OOM_ADJ_VALUES
	bool "Android Low Memory Killer: detect oom_adj values"
	depends on ANDROID_LOW_MEMORY_KILLER
	default y
	---help---
	  Detect oom_adj values written to
	  /sys/module/lowmemorykiller/parameters/adj and convert them
	  to oom_score_adj values.

config ANDROID_VSOC
	tristate "Android Virtual SoC support"
	default n
	depends on PCI_MSI
	---help---
	  This option adds support for the Virtual SoC driver needed to boot
	  a 'cuttlefish' Android image inside QEmu. The driver interacts with
	  a QEmu ivshmem device. If built as a module, it will be called vsoc.

config ANDROID_SIMPLE_LMK
	bool "Simple Android Low Memory Killer"
	depends on !ANDROID_LOW_MEMORY_KILLER
	---help---
	  This is a simple replacement for the Android Low Memory Killer
	  driver that simply targets a predefined number of pages to be freed
	  every time a memory allocation attempt is about to utilize direct
	  reclaim. Processes are killed according to the priorities that
	  Android gives them; in other words, the least important processes are
	  always killed first.

source "drivers/staging/android/ion/Kconfig"

endif # if ANDROID

endmenu
```
